## config/west.yml
```yaml
manifest:
  remotes:
    - name: zmkfirmware
      url-base: https://github.com/zmkfirmware
    - name: salamantos
      url-base: https://github.com/salamantos
  projects:
    - name: zmk
      remote: salamantos
      revision: main
      import: app/west.yml
    - name: prospector-zmk-module
      remote: salamantos
      revision: feat/new-status-screens
  self:
    path: config
```
